## external_libs/homekit/Kconfig
```kconfig
menu "HomeKit"

config HOMEKIT_SPI_FLASH_BASE_ADDR
    string "SPI flash address for storing HomeKit data"
    default 0x200000
    help
        SPI flash address to store HomeKit related persisted data

config HOMEKIT_MAX_CLIENTS
    int "Maximum number of simultaneous clients"
    default 16
    help
        Maximum number of simultaneous clients allowed. New connections above this
        limit will be rejected. Each connection requires ~1100-1200 bytes of RAM

config HOMEKIT_SMALL
    bool "Minimize firmware size"
    default n
    help
        Configures components to use smaller (but slower) implementations. Helps
        decrease firmware size ~70KB at cost of increasing pair verify time

config HOMEKIT_DEBUG
    bool "Debug output"
    default n
    help
        Enable debug output to serial console

endmenu
```
